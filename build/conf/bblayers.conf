## build/conf/bblayers.conf
```bitbake
# POKY_BBLAYERS_CONF_VERSION is increased each time build/conf/bblayers.conf
# changes incompatibly
POKY_BBLAYERS_CONF_VERSION = "2"

BBPATH = "${TOPDIR}"
BBFILES ?= ""

BBLAYERS ?= " \
  ${TOPDIR}/../poky/meta \
  ${TOPDIR}/../poky/meta-poky \
  ${TOPDIR}/../poky/meta-yocto-bsp \
  ${TOPDIR}/../meta-openembedded/meta-oe \
  ${TOPDIR}/../meta-openembedded/meta-python \
  ${TOPDIR}/../meta-openembedded/meta-multimedia \
  ${TOPDIR}/../meta-openembedded/meta-networking \
  ${TOPDIR}/../meta-arm/meta-arm-toolchain \
  ${TOPDIR}/../meta-arm/meta-arm \
  ${TOPDIR}/../meta-renesas/meta-rz-bsp \
  ${TOPDIR}/../meta-renesas/meta-rz-boards \
  ${TOPDIR}/../meta-rz-features/meta-rz-graphics \
  ${TOPDIR}/../meta-rz-features/meta-rz-drpai \
  ${TOPDIR}/../meta-rz-features/meta-rz-opencva \
  ${TOPDIR}/../meta-rz-features/meta-rz-codecs \
  ${TOPDIR}/../meta-mxt \
  ${TOPDIR}/../meta-hailo/meta-hailo-accelerator \
  ${TOPDIR}/../meta-hailo/meta-hailo-libhailort \
  ${TOPDIR}/../meta-hailo/meta-hailo-tappas \
  "
```

## meta-renesas/meta-rz-boards/conf/machine/rzv2n-evk.conf
```bitbake
#@TYPE: Machine
#@NAME: rzv2n-evk machine
#@DESCRIPTION: RZ/V2N Development Board platform

require conf/machine/include/arm/armv8-2a/tune-cortexa55.inc
require conf/machine/include/rz-common.inc
require conf/machine/include/rzv2h-family.inc

# Trusted Firmware-A configuration
PREFERRED_VERSION_trusted-firmware-a ?= "2.10%"
TFA_PLATFORM ?= "v2n"
TFA_BOARD ?= "evk_1 ENABLE_STACK_PROTECTOR=default"
TFA_UBOOT ?= "1"
TFA_BUILD_TARGET ?= "bl2 bl31 fip"
BL2_BOOT_TARGET ?= "spi mmc esd"
BL2_BASE_ADDR = "0x08103000"

BL2_ADJUST_VMA ?= "0x08101E00"
FIP_ADJUST_VMA ?= "0x0000"

UBOOT_CONFIG ??= "rzv2n-evk"
UBOOT_CONFIG[rzv2n-evk] = "rzv2n-evk_defconfig"
PREFERRED_VERSION_u-boot = "v2021.10%"

#todo temporary has no flash writer
# Flash Writer configuration
# FLASH_WRITER_BOARD ?= ""

# Supported devicetree
KERNEL_IMAGETYPE ?= "Image"
KERNEL_DEVICETREE = " \
	renesas/r9a09g056n44-evk.dtb \
"

IMAGE_BOOT_FILES = " \
	bl2_bp_spi-${MACHINE}.bin \
	bl2_bp_mmc-${MACHINE}.bin \
	bl2_bp_spi-${MACHINE}.srec \
	bl2_bp_mmc-${MACHINE}.srec \
	fip-${MACHINE}.srec \
	Flash_Writer_SCIF_RZV2N_DEV_LPDDR4X.mot \
"
#todo temporary has no flash writer add do_image_wic[noexec] to local.conf
WIC_INPUT_DEPENDS = "firmware-pack:do_deploy flash-writer:do_deploy"

MACHINE_FEATURES:append = " mali-g31"
```

## meta-renesas/meta-rz-bsp/conf/machine/include/rzv2h-family.inc
```bitbake
require conf/machine/include/soc-family.inc
SOC_FAMILY = "rzv2h-family:mali-family"

# Machine configuration
MACHINE_FEATURES = " opengles opencl hwh264enc hwh264dec hwh265enc hwh265dec"

IMAGE_FSTYPES:append = " tar.bz2 ext4"

# Configuration for ARM Trusted Firmware
EXTRA_IMAGEDEPENDS += " trusted-firmware-a"

# flash writer
EXTRA_IMAGEDEPENDS += " flash-writer"

# Firmware-pack
EXTRA_IMAGEDEPENDS += " firmware-pack"
```
