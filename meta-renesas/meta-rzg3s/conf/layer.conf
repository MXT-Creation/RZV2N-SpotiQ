## meta-renesas/meta-rzg3s/conf/layer.conf
```bitbake
# We have a conf and classes directory, add to BBPATH
BBPATH .= ":${LAYERDIR}"

# We have recipes-* directories, add to BBFILES
BBFILES += "${LAYERDIR}/recipes-*/*/*.bb \
            ${LAYERDIR}/recipes-*/*/*.bbappend"

BBFILE_COLLECTIONS += "rzg3s"
BBFILE_PATTERN_rzg3s = "^${LAYERDIR}/"
BBFILE_PRIORITY_rzg3s = "15"

LAYERDEPENDS_rzg3s = "rz-common"
LAYERSERIES_COMPAT_rzg3s = "dunfell"
```

## meta-renesas/meta-rzg3s/conf/machine/include/r9a08g045.inc
```bitbake
require conf/machine/include/rzg2-common.inc
require conf/machine/include/soc-family.inc

LINUXLIBCVERSION = "5.10%"

MACHINEOVERRIDES =. "rzg3s:"
```
